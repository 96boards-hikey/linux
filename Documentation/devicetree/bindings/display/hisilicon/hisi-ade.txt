## Documentation/devicetree/bindings/display/hisilicon/hisi-ade.txt
```
Device-Tree bindings for hisilicon ADE display controller driver

ADE (Advanced Display Engine) is the display controller which grab image
data from memory, do composition, do post image processing, generate RGB
timing stream and transfer to DSI.

Required properties:
- compatible: value should be one of the following
	"hisilicon,hi6220-ade".
- reg: physical base address and length of the controller's registers.
- reg-names: name of physical base.
- interrupt: the interrupt number.
- clocks: the clocks needed.
- clock-names: the name of the clocks.
- ade_core_clk_rate: ADE core clock rate.
- media_noc_clk_rate: media noc module clock rate.


A example of HiKey board hi6220 SoC specific DT entry:
Example:

	ade: ade@f4100000 {
		compatible = "hisilicon,hi6220-ade";
		reg = <0x0 0xf4100000 0x0 0x7800>,
		      <0x0 0xf4410000 0x0 0x1000>;
		reg-names = "ade_base",
			    "media_base";
		interrupts = <0 115 4>;

		clocks = <&media_ctrl HI6220_ADE_CORE>,
			 <&media_ctrl HI6220_CODEC_JPEG>,
			 <&media_ctrl HI6220_ADE_PIX_SRC>,
			 <&media_ctrl HI6220_PLL_SYS>,
			 <&media_ctrl HI6220_PLL_SYS_MEDIA>;
		clock-names  = "clk_ade_core",
			       "aclk_codec_jpeg_src",
			       "clk_ade_pix",
			       "clk_syspll_src",
			       "clk_medpll_src";
		ade_core_clk_rate = <360000000>;
		media_noc_clk_rate = <288000000>;
	};
```

## Documentation/devicetree/bindings/display/hisilicon/hisi-drm.txt
```
Hisilicon DRM master device

The Hisilicon DRM master device is a virtual device needed to list all
the other display relevant nodes that comprise the display subsystem.


Required properties:
- compatible: Should be "hisilicon,<chip>-dss"
- #address-cells: should be set to 2.
- #size-cells: should be set to 2.
- range: to allow probing of subdevices.

Optional properties:
- dma-coherent: Present if dma operations are coherent.

Required sub nodes:
All the device nodes of display subsystem of SoC should be the sub nodes.
Such as display controller node, DSI node and so on.

A example of HiKey board hi6220 SoC specific DT entry:
Example:

	display-subsystem {
		compatible = "hisilicon,hi6220-dss";
		#address-cells = <2>;
		#size-cells = <2>;
		ranges;
		dma-coherent;

		ade: ade@f4100000 {
			compatible = "hisilicon,hi6220-ade";
			reg = <0x0 0xf4100000 0x0 0x7800>,
			      <0x0 0xf4410000 0x0 0x1000>;
			reg-names = "ade_base",
				    "media_base";
			interrupts = <0 115 4>; /* ldi interrupt */

			clocks = <&media_ctrl HI6220_ADE_CORE>,
				 <&media_ctrl HI6220_CODEC_JPEG>,
				 <&media_ctrl HI6220_ADE_PIX_SRC>,
				 <&media_ctrl HI6220_PLL_SYS>,
				 <&media_ctrl HI6220_PLL_SYS_MEDIA>;
			/*clock name*/
			clock-names  = "clk_ade_core",
				       "aclk_codec_jpeg_src",
				       "clk_ade_pix",
				       "clk_syspll_src",
				       "clk_medpll_src";
			ade_core_clk_rate = <360000000>;
			media_noc_clk_rate = <288000000>;
		};

		dsi: dsi@0xf4107800 {
			compatible = "hisilicon,hi6220-dsi";
			reg = <0x0 0xf4107800 0x0 0x100>;
			clocks = <&media_ctrl  HI6220_DSI_PCLK>;
			clock-names = "pclk_dsi";

			port {
				dsi_out: endpoint {
					remote-endpoint = <&adv_in>;
				};
			};

		};
	};
```

## Documentation/devicetree/bindings/display/hisilicon/hisi-dsi.txt
```
Device-Tree bindings for hisilicon DSI controller driver

A DSI controller resides in the middle of display controller and external
HDMI converter.

Required properties:
- compatible: value should be one of the following
	"hisilicon,hi6220-dsi".
- reg: physical base address and length of the controller's registers.
- clocks: the clocks needed.
- clock-names: the name of the clocks.
- port: DSI controller output port. This contains one endpoint subnode, with its
  remote-endpoint set to the phandle of the connected external HDMI endpoint.
  See Documentation/devicetree/bindings/graph.txt for device graph info.

A example of HiKey board hi6220 SoC and board specific DT entry:
Example:

SoC specific:
	dsi: dsi@0xf4107800 {
		compatible = "hisilicon,hi6220-dsi";
		reg = <0x0 0xf4107800 0x0 0x100>;
		clocks = <&media_ctrl  HI6220_DSI_PCLK>;
		clock-names = "pclk_dsi";

		port {
			dsi_out: endpoint {
				remote-endpoint = <&adv_in>;
			};
		};

	};

Board specific:
	i2c2: i2c@f7102000 {
		status = "ok";

		adv7533: adv7533@39 {
			compatible = "adi,adv7533";
			reg = <0x39>;
			interrupt-parent = <&gpio1>;
			interrupts = <1 2>;
			pd-gpio = <&gpio0 4 0>;
			adi,dsi-lanes = <4>;

			port {
				adv_in: endpoint {
					remote-endpoint = <&dsi_out>;
				};
			};
		};
	};
```

## Documentation/devicetree/bindings/mfd/hisilicon,hi655x.txt
```
Hisilicon hi655x Power Management Integrated Circuit (PMIC)

The hardware layout for access PMIC Hi655x from AP SoC Hi6220.
Between PMIC Hi655x and Hi6220, the physical signal channel is SSI.
We can use memory-mapped I/O to communicate.

+----------------+             +-------------+
|                |             |             |
|    Hi6220      |   SSI bus   |   Hi655x    |
|                |-------------|             |
|                |(REGMAP_MMIO)|             |
+----------------+             +-------------+

Required properties:
- compatible: Should be "hisilicon,hi655x-pmic"
- reg: Base address of PMIC on hi6220 soc
- interrupt-controller: Hi655x has internal IRQs (has own IRQ domain).
- pmic-gpios: The gpio used by PMIC irq.

Example:
	pmic: pmic@f8000000 {
		compatible = "hisilicon,hi655x-pmic";
		reg = <0x0 0xf8000000 0x0 0x1000>;
		interrupt-controller;
		#interrupt-cells = <2>;
		pmic-gpios = <&gpio1 2 GPIO_ACTIVE_HIGH>;
	}
```

## Documentation/devicetree/bindings/pci/hisilicon-pcie.txt
```
HiSilicon Hip05 and Hip06 PCIe host bridge DT description

HiSilicon PCIe host controller is based on Designware PCI core.
It shares common functions with PCIe Designware core driver and inherits
common properties defined in
Documentation/devicetree/bindings/pci/designware-pci.txt.

Additional properties are described here:

Required properties
- compatible: Should contain "hisilicon,hip05-pcie" or "hisilicon,hip06-pcie".
- reg: Should contain rc_dbi, config registers location and length.
- reg-names: Must include the following entries:
  "rc_dbi": controller configuration registers;
  "config": PCIe configuration space registers.
- msi-parent: Should be its_pcie which is an ITS receiving MSI interrupts.
- port-id: Should be 0, 1, 2 or 3.

Optional properties:
- status: Either "ok" or "disabled".
- dma-coherent: Present if DMA operations are coherent.

Hip05 Example (note that Hip06 is the same except compatible):
	pcie@0xb0080000 {
		compatible = "hisilicon,hip05-pcie", "snps,dw-pcie";
		reg = <0 0xb0080000 0 0x10000>, <0x220 0x00000000 0 0x2000>;
		reg-names = "rc_dbi", "config";
		bus-range = <0  15>;
		msi-parent = <&its_pcie>;
		#address-cells = <3>;
		#size-cells = <2>;
		device_type = "pci";
		dma-coherent;
		ranges = <0x82000000 0 0x00000000 0x220 0x00000000 0 0x10000000>;
		num-lanes = <8>;
		port-id = <1>;
		#interrupt-cells = <1>;
		interrupt-map-mask = <0xf800 0 0 7>;
		interrupt-map = <0x0 0 0 1 &mbigen_pcie 1 10
				 0x0 0 0 2 &mbigen_pcie 2 11
				 0x0 0 0 3 &mbigen_pcie 3 12
				 0x0 0 0 4 &mbigen_pcie 4 13>;
		status = "ok";
	};


HiSilicon Kirin SoC PCIe host DT description

Kirin PCIe host controller is also based on Designware PCI core.
It shares common functions with PCIe Designware core driver and inherits
common properties defined in
Documentation/devicetree/bindings/pci/designware-pci.txt.

Additional properties are described here:

Required properties
- compatible: Should contain "hisilicon,kirin-pcie".
- reg: Should contain rc_dbi, apb, phy, config registers location and length.
- reg-names: Must include the following entries:
  "dbi": controller configuration registers;
  "apb": apb Ctrl register;
  "phy": apb PHY register;
  "config": PCIe configuration space registers.
- reset-gpio: perst assert/deassert gpio

Optional properties:
- status: Either "ok" or "disabled".

Kirin960 Example:
        kirin_pcie_rc@f4000000 {
                        compatible = "hisilicon,kirin-pcie";
                        reg =  <0x0 0xf4000000 0x0 0x1000>, <0x0 0xff3fe000 0x0 0x1000>,
                                 <0x0 0xf3f20000 0x0 0x40000>, <0x0 0xF5000000 0 0x2000>;
                        reg-names = "dbi","apb","phy", "config";
                        bus-range = <0x0  0x1>;
                        #address-cells = <3>;
                        #size-cells = <2>;
                        device_type = "pci";
                        ranges = <0x02000000 0x0 0x00000000 0x0 0xf6000000 0x0 0x2000000>;
                        num-lanes = <1>;
                        #interrupt-cells = <1>;
                        interrupt-map-mask = <0xf800 0 0 7>;
			interrupt-map = <0x0 0 0 2 &gic 0 0 0  283 4>,
                                        <0x0 0 0 3 &gic 0 0 0  284 4>,
                                        <0x0 0 0 4 &gic 0 0 0  285 4>;
                        clocks = <&crg_ctrl HI3660_PCIEPHY_REF>,
                                <&crg_ctrl HI3660_CLK_GATE_PCIEAUX>,
                                <&crg_ctrl HI3660_PCLK_GATE_PCIE_PHY>,
                                <&crg_ctrl HI3660_PCLK_GATE_PCIE_SYS>,
                                <&crg_ctrl HI3660_ACLK_GATE_PCIE>;
                        clock-names = "pcie_phy_ref", "pcie_aux",
                                "pcie_apb_phy", "pcie_apb_sys", "pcie_aclk";
                        reset-gpio = <&gpio11 1 0 >;
                        status = "ok";
        };
```

## Documentation/devicetree/bindings/pci/kirin-pcie.txt
```
HiSilicon Kirin SoCs PCIe host DT description

Kirin PCIe host controller is based on Designware PCI core.
It shares common functions with PCIe Designware core driver
and inherits common properties defined in
Documentation/devicetree/bindings/pci/designware-pci.txt.

Additional properties are described here:

Required properties
- compatible:
	"hisilicon,hikey960" for PCIe of Kirin960 SoC or
	"hisilicon,hikey970" for PCIe of Kirin970 SoC
- reg: Should contain rc_dbi, apb, phy, config registers location and length.
- reg-names: Must include the following entries:
  "dbi": controller configuration registers;
  "apb": apb Ctrl register defined by Kirin;
  "phy": apb PHY register defined by Kirin;
  "config": PCIe configuration space registers.
- reset-gpios: The gpio to generate PCIe perst assert and deassert signal.

Optional properties:

Example based on kirin960:

	pcie@f4000000 {
			compatible = "hisilicon,hikey960";
			reg = <0x0 0xf4000000 0x0 0x1000>,
			      <0x0 0xff3fe000 0x0 0x1000>,
			      <0x0 0xf3f20000 0x0 0x40000>,
			      <0x0 0xf5000000 0x0 0x2000>;
			reg-names = "dbi", "apb", "phy", "config";
			bus-range = <0x0  0x1>;
			#address-cells = <3>;
			#size-cells = <2>;
			device_type = "pci";
			ranges = <0x02000000 0x0 0x00000000
				  0x0 0xf6000000
				  0x0 0x02000000>;
			num-lanes = <1>;
			#interrupt-cells = <1>;
			interrupt-map-mask = <0xf800 0 0 7>;
			interrupt-map = <0x0 0 0 1
					 &gic GIC_SPI 282 IRQ_TYPE_LEVEL_HIGH>,
					<0x0 0 0 2
					 &gic GIC_SPI 283 IRQ_TYPE_LEVEL_HIGH>,
					<0x0 0 0 3
					 &gic GIC_SPI 284 IRQ_TYPE_LEVEL_HIGH>,
					<0x0 0 0 4
					 &gic GIC_SPI 285 IRQ_TYPE_LEVEL_HIGH>;
			clocks = <&crg_ctrl HI3660_PCIEPHY_REF>,
				 <&crg_ctrl HI3660_CLK_GATE_PCIEAUX>,
				 <&crg_ctrl HI3660_PCLK_GATE_PCIE_PHY>,
				 <&crg_ctrl HI3660_PCLK_GATE_PCIE_SYS>,
				 <&crg_ctrl HI3660_ACLK_GATE_PCIE>;
			clock-names = "pcie_phy_ref", "pcie_aux",
				      "pcie_apb_phy", "pcie_apb_sys",
				      "pcie_aclk";
			reset-gpios = <&gpio11 1 0 >;
		};

Example based on kirin970:

	pcie@f4000000 {
			compatible = "hisilicon,hikey970";
			reg = <0x0 0xf4000000 0x0 0x1000000>,
			      <0x0 0xfc180000 0x0    0x1000>,
			      <0x0 0xfc040000 0x0   0x40000>,
			      <0x0 0xf5000000 0x0    0x2000>;
			reg-names = "dbi", "apb", "phy", "config";
			bus-range = <0x0  0x1>;
			#address-cells = <3>;
			#size-cells = <2>;
			device_type = "pci";
			ranges = <0x02000000 0x0 0x00000000
				  0x0 0xf6000000
				  0x0 0x02000000>;
			num-lanes = <1>;
			#interrupt-cells = <1>;
			interrupt-map-mask = <0xf800 0 0 7>;
			interrupt-map = <0x0 0 0 1
					 &gic GIC_SPI 282 IRQ_TYPE_LEVEL_HIGH>,
					<0x0 0 0 2
					 &gic GIC_SPI 283 IRQ_TYPE_LEVEL_HIGH>,
					<0x0 0 0 3
					 &gic GIC_SPI 284 IRQ_TYPE_LEVEL_HIGH>,
					<0x0 0 0 4
					 &gic GIC_SPI 285 IRQ_TYPE_LEVEL_HIGH>;
			clocks = <&crg_ctrl KIRIN970_CLK_GATE_PCIEAUX>,
				 <&crg_ctrl KIRIN970_PCLK_GATE_PCIE_PHY>,
				 <&crg_ctrl KIRIN970_PCLK_GATE_PCIE_SYS>,
				 <&crg_ctrl KIRIN970_ACLK_GATE_PCIE>;
			clock-names = "pcie_aux", "pcie_apb_phy",
				      "pcie_apb_sys", "pcie_aclk";
			reset-gpios = <&gpio7 0 0 >;
		};
```

## Documentation/devicetree/bindings/phy/phy-hi3660-usb3.txt
```
Hisilicon hi3660 usb PHY
-----------------------

Required properties:
- compatible: should be "hisilicon,hi3660-usb-phy"
- #phy-cells: must be 0
- hisilicon,pericrg-syscon: phandle of syscon used to control phy.
- hisilicon,pctrl-syscon: phandle of syscon used to control phy.
- hisilicon,usb3-otg-bc-syscon: phandle of syscon used to control phy.
- eye-diagram-param: parameter set for phy
Refer to phy/phy-bindings.txt for the generic PHY binding properties

Example:
	usb_phy: usbphy {
		compatible = "hisilicon,hi3660-usb-phy";
		#phy-cells = <0>;
		hisilicon,pericrg-syscon = <&crg_ctrl>;
		hisilicon,pctrl-syscon = <&pctrl>;
		hisilicon,usb3-otg-bc-syscon = <&usb3_otg_bc>;
		eye-diagram-param = <0x22466e4>;
	};
```

## Documentation/devicetree/bindings/regulator/hisilicon,hi655x-regulator.txt
```
Hisilicon Hi655x Voltage regulators

Note:
The hi655x regulator control is managed by hi655x Power IC.
So the node of this regulator must be child node of hi655x
PMIC node.

The driver uses the regulator core framework, so please also
take the bindings of regulator.txt for reference.

The valid names for regulators are:

LDO2 LDO7 LDO10 LDO13 LDO14 LDO15 LDO17 LDO19 LDO21 LDO22

Example:
        pmic: pmic@f8000000 {
                compatible = "hisilicon,hi655x-pmic";
		...
		regulators {
			ldo2: LDO2@a21 {
				regulator-compatible = "LDO2_2V8";
				regulator-min-microvolt = <2500000>;
				regulator-max-microvolt = <3200000>;
				regulator-enable-ramp-delay = <120>;
			};
			...
		}
	}
```

## Documentation/devicetree/bindings/reset/hisilicon,kirin970-usb31-misc-reset.txt
```
Hisilicon USB31 Misc Reset Controller
======================================

Please also refer to reset.txt in this directory for common reset
controller binding usage.

The reset controller registers are part of the system-ctl block on
Kirin970 SoC.

Required properties:
- compatible: should be
		 "hisilicon,kirin970-usb31-misc-reset"
- hisi,rst-syscon: phandle of the reset's syscon.
- #reset-cells : Specifies the number of cells needed to encode a
  reset source.  The type shall be a <u32> and the value shall be 2.

	 Cell #1 : offset of the reset assert control
	           register from the syscon register base
	 Cell #2 : bit position of the reset in the reset control register

Example:
	usb31_misc: usb31_misc@ff200000 {
		compatible = "syscon";
		reg = <0x0 0xff200000 0x0 0x1000>;
	};

	usb31_misc_rst: usb31_misc_rst_controller {
		compatible = "hisilicon,kirin970-usb31-misc-reset";
		#reset-cells = <2>;
		hisi,rst-syscon = <&usb31_misc>;
	};

Specifying reset lines connected to IP modules
==============================================
example:

        usb3: hisi_dwc3@..... {
                ...
		resets = <&usb31_misc_rst 0xA0 8>; /* offset: 0xA0; bit: 8 */
                ...
        };
```
