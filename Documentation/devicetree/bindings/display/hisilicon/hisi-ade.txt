## drivers/misc/microchip/hub/Kconfig
```kconfig
config HUB_USB5734
    tristate "HUB_USB5734"
    depends on GPIOLIB
    default n
    help
       If you say yes here you get support for HUB_USB5734.
```
