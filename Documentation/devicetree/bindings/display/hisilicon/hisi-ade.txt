## Documentation/devicetree/bindings/thermal/hi3660-thermal.txt
```
* Temperature Sensor on hisilicon hi3660 SoC

** Required properties :

- compatible: "hisilicon,thermal-hi3660".
- reg: physical base address of thermal sensor and length of memory mapped
  region.
- #thermal-sensor-cells: Should be 1. See ./thermal.txt for a description.

Example :

	tsensor: tsensor {
		compatible = "hisilicon,thermal-hi3660";
		reg = <0x0 0xfff30000 0x0 0x1000>;
		#thermal-sensor-cells = <1>;
	 };
```

## Documentation/devicetree/bindings/ufs/hi3660-ufs.txt
```
* Hisilicon Universal Flash Storage (UFS) Host Controller

UFS nodes are defined to describe on-chip UFS hardware macro.
Each UFS Host Controller should have its own node.

Required properties:
- compatible        : compatible list, contains one of the following -
			"hisilicon,hi3660-ufs" for hisi ufs host controller
			 present on Hi3660 chipset.
- reg               : should contain UFS register address space & UFS SYS CTRL register address,
- interrupt-parent  : interrupt device
- interrupts        : interrupt number
- clocks	        : List of phandle and clock specifier pairs
- clock-names       : List of clock input name strings sorted in the same
		      order as the clocks property. "clk_ref", "clk_phy" is optional
- resets            : reset node register, one reset the clk and the other reset the controller
- reset-names       : describe reset node register

Optional properties for board device:
- ufs-hi3660-use-rate-B		: specifies UFS rate-B
- ufs-hi3660-broken-fastauto	: specifies no fastauto
- ufs-hi3660-use-HS-GEAR3	: specifies UFS HS-GEAR3
- ufs-hi3660-use-HS-GEAR2	: specifies UFS HS-GEAR2
- ufs-hi3660-use-HS-GEAR1	: specifies UFS HS-GEAR1
- ufs-hi3660-broken-clk-gate-bypass	: specifies no clk-gate
- ufs-hi3660-use-one-line	: specifies UFS use one line work
- reset-gpio			: specifies to reset devices

Example:

		ufs: ufs@ff3b0000 {
			compatible = "jedec,ufs-1.1", "hisilicon,hi3660-ufs";
			/* 0: HCI standard */
			/* 1: UFS SYS CTRL */
			reg = <0x0 0xff3b0000 0x0 0x1000>,
				<0x0 0xff3b1000 0x0 0x1000>;
			interrupt-parent = <&gic>;
			interrupts = <GIC_SPI 278 IRQ_TYPE_LEVEL_HIGH>;
			clocks = <&crg_ctrl HI3660_CLK_GATE_UFSIO_REF>,
				<&crg_ctrl HI3660_CLK_GATE_UFSPHY_CFG>;
			clock-names = "clk_ref", "clk_phy";
			freq-table-hz = <0 0>, <0 0>;
			/* offset: 0x84; bit: 12 */
			/* offset: 0x84; bit: 7  */
			resets = <&crg_rst 0x84 12>,
				<&crg_rst 0x84 7>;
			reset-names = "rst", "assert";
		}

		&ufs {
		        ufs-hi3660-use-rate-B;
		        ufs-hi3660-broken-fastauto;
		        ufs-hi3660-use-HS-GEAR3;
			ufs-hi3660-broken-clk-gate-bypass;
			reset-gpio = <&gpio18 1 0>;
			status = "okay";
		}
```

## Documentation/devicetree/bindings/ufs/ufs-hisi.txt
```
* Hisilicon Universal Flash Storage (UFS) Host Controller

UFS nodes are defined to describe on-chip UFS hardware macro.
Each UFS Host Controller should have its own node.

Required properties:
- compatible        : compatible list, contains one of the following -
					"hisilicon,hi3660-ufs", "jedec,ufs-1.1" for hisi ufs
					host controller present on Hi36xx chipset.
- reg               : should contain UFS register address space & UFS SYS CTRL register address,
- interrupt-parent  : interrupt device
- interrupts        : interrupt number
- clocks	        : List of phandle and clock specifier pairs
- clock-names       : List of clock input name strings sorted in the same
					order as the clocks property. "ref_clk", "phy_clk" is optional
- resets            : reset node register, one reset the clk and the other reset the controller
- reset-names       : describe reset node register

Example:

	ufs: ufs@ff3b0000 {
		compatible = "hisilicon,hi3660-ufs", "jedec,ufs-1.1";
		/* 0: HCI standard */
		/* 1: UFS SYS CTRL */
		reg = <0x0 0xff3b0000 0x0 0x1000>,
			<0x0 0xff3b1000 0x0 0x1000>;
		interrupt-parent = <&gic>;
		interrupts = <GIC_SPI 278 IRQ_TYPE_LEVEL_HIGH>;
		clocks = <&crg_ctrl HI3660_CLK_GATE_UFSIO_REF>,
			<&crg_ctrl HI3660_CLK_GATE_UFSPHY_CFG>;
		clock-names = "ref_clk", "phy_clk";
		freq-table-hz = <0 0>, <0 0>;
		/* offset: 0x84; bit: 12 */
		/* offset: 0x84; bit: 7  */
		resets = <&crg_rst 0x84 12>,
			<&crg_rst 0x84 7>;
		reset-names = "rst", "assert";
	};
```

## Documentation/devicetree/bindings/usb/dwc3-hisi.txt
```
HiSilicon DWC3 USB SoC controller

This file documents the parameters for the dwc3-hisi driver.

Required properties:
- compatible:	should be "hisilicon,hi3660-dwc3" or "hisilicon,kirin970-dwc3"
- clocks:	A list of phandle + clock-specifier pairs for the
		clocks listed in clock-names
- clock-names:	Specify clock names
- resets:	list of phandle and reset specifier pairs.

Sub-nodes:
The dwc3 core should be added as subnode to HiSilicon DWC3 as shown in the
example below. The DT binding details of dwc3 can be found in:
Documentation/devicetree/bindings/usb/dwc3.txt

Example:
	usb3: hisi_dwc3 {
		compatible = "hisilicon,hi3660-dwc3";
		#address-cells = <2>;
		#size-cells = <2>;
		ranges;

		clocks = <&crg_ctrl HI3660_CLK_ABB_USB>,
			 <&crg_ctrl HI3660_ACLK_GATE_USB3OTG>;
		clock-names = "clk_usb3phy_ref", "aclk_usb3otg";
		assigned-clocks = <&crg_ctrl HI3660_ACLK_GATE_USB3OTG>;
		assigned-clock-rates = <229000000>;
		resets = <&crg_rst 0x90 8>,
			 <&crg_rst 0x90 7>,
			 <&crg_rst 0x90 6>,
			 <&crg_rst 0x90 5>;

		dwc3: dwc3@ff100000 {
			compatible = "snps,dwc3";
			reg = <0x0 0xff100000 0x0 0x100000>;
			interrupts = <0 159 4>, <0 161 4>;
			phys = <&usb_phy>;
			phy-names = "usb3-phy";
			dr_mode = "otg";
			maximum-speed = "super-speed";
			phy_type = "utmi";
			snps,dis-del-phy-power-chg-quirk;
			snps,lfps_filter_quirk;
			snps,dis_u2_susphy_quirk;
			snps,dis_u3_susphy_quirk;
			snps,tx_de_emphasis_quirk;
			snps,tx_de_emphasis = <1>;
			snps,dis_enblslpm_quirk;
			extcon = <&hisi_pd>;
		};
	};

	usb3: hisi_dwc3 {
		compatible = "hisilicon,kirin970-dwc3";
		#address-cells = <2>;
		#size-cells = <2>;
		ranges;

		clocks = <&crg_ctrl KIRIN970_CLK_GATE_ABB_USB>,
			 <&crg_ctrl KIRIN970_HCLK_GATE_USB3OTG>,
			 <&crg_ctrl KIRIN970_CLK_GATE_USB3OTG_REF>,
			 <&crg_ctrl KIRIN970_ACLK_GATE_USB3DVFS>;
		clock-names = "clk_gate_abb_usb",
			      "hclk_gate_usb3otg",
			      "clk_gate_usb3otg_ref",
			      "aclk_gate_usb3dvfs";
		assigned-clocks = <&crg_ctrl KIRIN970_ACLK_GATE_USB3DVFS>;
		assigned-clock-rates = <238000000>;
		resets = <&crg_rst 0x90 6>,
			 <&crg_rst 0x90 7>,
			 <&usb31_misc_rst 0xA0 8>,
			 <&usb31_misc_rst 0xA0 9>;

		dwc3: dwc3@ff100000 {
			compatible = "snps,dwc3";
			reg = <0x0 0xff100000 0x0 0x100000>;
			interrupts = <0 159 4>, <0 161 4>;
			phys = <&usb_phy>;
			phy-names = "usb3-phy";
			dr_mode = "otg";
			maximum-speed = "super-speed";
			phy_type = "utmi";
			snps,dis-del-phy-power-chg-quirk;
			snps,dis_u2_susphy_quirk;
			snps,dis_u3_susphy_quirk;
			snps,tx_de_emphasis_quirk;
			snps,tx_de_emphasis = <1>;
			extcon = <&hisi_pd>;
		};
	};
```

## Documentation/devicetree/bindings/usb/hisilicon-hikey-usb.txt
```
Hisilicon support  hub controller
-----------------------------


Required properties:
- compatible: "hisilicon,gpio_hubv1","hisilicon,gpio_hubv2"

Example
-----

	hubv2: gpio_hubv2 {
		compatible = "hisilicon,gpio_hubv2";
		typc_vbus_int_gpio,typec-gpios = <&gpio25 2 0>;
		typc_vbus_enable_val = <1>;
		otg_gpio = <&gpio25 6 0>;
		hub_vdd12_en_gpio = <&gpio2 1 0>;
		hub_vdd33_en_gpio = <&gpio5 6 0>;
		hub_reset_en_gpio = <&gpio4 4 0>;
		pinctrl-names = "default";
		pinctrl-0 = <&usbhub5734_pmx_func>;
	};
```
