## drivers/platform/hisi/Kconfig
```kconfig
config HISI_FIQ_DEBUGGER
	bool "Enable the FIQ serial debugger on Hisi"
	default n
	select FIQ_DEBUGGER
	help
	  Enables the FIQ serial debugger on Hisi
config HISI_HW_CFG_MGR
	bool "Enable HW config manager on Hisi"
	default n
	depends on GPIOLIB
	help
	  Enables HW config manager on Hisi
```

## drivers/reset/hisilicon/Kconfig
```kconfig
config COMMON_RESET_HI3660
	tristate "Hi3660 Reset Driver"
	depends on ARCH_HISI || COMPILE_TEST
	default ARCH_HISI
	help
	  Build the Hisilicon Hi3660 reset driver.

config COMMON_RESET_HI6220
	tristate "Hi6220 Reset Driver"
	depends on ARCH_HISI || COMPILE_TEST
	default ARCH_HISI
	help
	  Build the Hisilicon Hi6220 reset driver.

config COMMON_RESET_USB31MISC_KIRIN970
	tristate "Kirin970 USB31 Misc Reset Driver"
	depends on ARCH_HISI || COMPILE_TEST
	default ARCH_HISI
	help
	  Build the Hisilicon Kirin970 USB31 Misc reset driver.
```

## drivers/usb/pd/richtek/Kconfig
```kconfig
config TCPC_CLASS
	bool "TypeC Port Controller Device Class"
	help
	  Say Y to enable
	  Typec Port
	  Controller Device
	  Class

config USB_POWER_DELIVERY
	bool "Support USB power delivery Function"
	default n
	help
	  Say Y to enable
	  USB
	  Power Delivery
	  support

config TCPC_RT1711H
	bool "Richtek RT1711H TypeC port Controller Driver"
	depends on TCPC_CLASS
	default n
	help
	  Say Y to enable
	  Richtek RT1711H
	  TypeC port Controller
	  Driver

config USB_PD_VBUS_STABLE_TOUT
    	int "PD VBUS Stable Timeout"
    	depends on USB_POWER_DELIVERY
    	range 0 1000                       # >= 0,  <= 1000
    	default 125
    	help
          Setup a timeout value (ms)
	  for
	  VBUS change
	  stable

config USB_PD_VBUS_PRESENT_TOUT
    	int "PD VBUS Present Timeout"
    	depends on USB_POWER_DELIVERY
    	range 0 1000                       # >= 0,  <= 1000
    	default 20
    	help
          Setup a timeout value (ms)
	  for
	  VBUS present
	  stable
```

## drivers/video/fbdev/hisi/Kconfig
```kconfig
config HISI_FB_KIRIN960
	tristate "HISI FB KIRIN960 Framebuffer support"
	depends on FB
	select FB_CFB_FILLRECT
	select FB_CFB_COPYAREA
	select FB_CFB_IMAGEBLIT
	select REGMAP
	help
	  This framebuffer driver supports KIRIN960 FB.
```

## sound/soc/hisilicon/Kconfig
```kconfig
config SND_I2S_HISI_I2S
	tristate "Hisilicon I2S controller"
	select SND_SOC_GENERIC_DMAENGINE_PCM
	help
	  Hisilicon I2S
```
